## besom/Kconfig.shield
```kconfig
# Copyright (c) 2020 Pete Johanson
# SPDX-License-Identifier: MIT

config SHIELD_BESOM_LEFT
	def_bool $(shields_list_contains,besom_left)

config SHIELD_BESOM_RIGHT
	def_bool $(shields_list_contains,besom_right)
```

## config/west.yml
```yaml
manifest:
  remotes:
    - name: zmkfirmware
      url-base: https://github.com/zmkfirmware
    - name: tominabox1
      url-base: https://github.com/tominabox1/
    - name: nicell
      url-base: https://github.com/Nicell/
    - name: okke
      url-base: https://github.com/okke-formsma
  projects:
    - name: zmk
      remote: okke
      revision: chormbos
      import: app/west.yml
  self:
    path: config
```
